## config/boards/shields/dmktest/Kconfig.defconfig
```kconfig
if SHIELD_DMKTEST

config ZMK_KEYBOARD_NAME
    default "DMK Test"

endif

if ZMK_BACKLIGHT

config PWM
    default y

config LED_PWM
    default y

endif # ZMK_BACKLIGHT
```

## config/boards/shields/whitepad5x7/Kconfig.defconfig
```kconfig
if SHIELD_WHITEPAD5X7

config ZMK_KEYBOARD_NAME
    default "Whitepad 5x7"

if ZMK_BACKLIGHT

config PWM
    default y

config LED_PWM
    default y

endif # ZMK_BACKLIGHT

endif # SHIELD_DMKTEST
```

## config/boards/whitepad5x7/Kconfig.defconfig
```kconfig
if SHIELD_WHITEPAD5X7

config ZMK_KEYBOARD_NAME
    default "whitepad 5x7"

if ZMK_BACKLIGHT

config PWM
    default y

config LED_PWM
    default y

endif # ZMK_BACKLIGHT

endif # SHIELD_DMKTEST
```
